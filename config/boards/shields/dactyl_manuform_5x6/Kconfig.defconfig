## config/boards/shields/dactyl_manuform_5x6/Kconfig.defconfig
```kconfig
if DACTYL_MANUFORM_5X6_LEFT

config ZMK_KEYBOARD_NAME
	default "dactyl manuform"

config ZMK_SPLIT_ROLE_CENTRAL
	default y

endif

if DACTYL_MANUFORM_5X6_LEFT || DACTYL_MANUFORM_5X6_RIGHT

config ZMK_SPLIT
	default y

endif
```

## config/boards/shields/dactyl_manuform_5x6/Kconfig.shield
```kconfig
config DACTYL_MANUFORM_5X6_LEFT
	def_bool $(shields_list_contains,dactyl_manuform_5x6_left)

config DACTYL_MANUFORM_5X6_RIGHT
	def_bool $(shields_list_contains,dactyl_manuform_5x6_right)
```

## config/boards/shields/lotus58/Kconfig.defconfig
```kconfig
# Copyright (c) 2022 The ZMK Contributors
# SPDX-License-Identifier: MIT

if SHIELD_LOTUS58_LEFT

    config ZMK_KEYBOARD_NAME
        default "Lotus58"

    config ZMK_SPLIT_ROLE_CENTRAL
        default y

    config I2C
        default y

endif

if SHIELD_LOTUS58_LEFT || SHIELD_LOTUS58_RIGHT

    config ZMK_SPLIT
        default y

endif
```

## config/boards/shields/lotus58/Kconfig.shield
```kconfig
config SHIELD_LOTUS58
	def_bool $(shields_list_contains,lotus58)

config SHIELD_LOTUS58_LEFT
	def_bool $(shields_list_contains,lotus58_left)

config SHIELD_LOTUS58_RIGHT
	def_bool $(shields_list_contains,lotus58_right)
```

## config/west.yml
```yaml
manifest:
  remotes:
    - name: zmkfirmware
      url-base: https://github.com/zmkfirmware
    - name: zmk-yackboard-3.2
      url-base: https://gitlab.com/voidyourwarranty
    - name: jgreel
      url-base: https://github.com/jgreel
    - name: zmk
      url-base: https://github.com/cdc-mkb
  projects:
    - name: zmk
      remote: jgreel
      revision: devel-mouse-pim447
      import: app/west.yml
  self:
    path: config
```
